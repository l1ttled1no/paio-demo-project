AUTOSAR XML (schema 00054)
package /System
  system System: category=SYSTEM_DESIGN_DESCRIPTION, system-version=1.0.0
    root-software-compositions:
      root sw composition prototype System: software-composition=System
