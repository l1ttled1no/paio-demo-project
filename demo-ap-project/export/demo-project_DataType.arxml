AUTOSAR XML (schema 00054)
standard types defined: boolean, float32, float64, sint8, sint16, sint32, sint64, uint8, uint16, uint32, uint64
package /DataTypes/ImplementationDataTypes
  impl type VehicleGearState_enm: compu-method=CM_VehicleGearState_enm, implementation-data-type=uint8
  impl type AirSuspensionSate_enm: compu-method=CM_AirSuspensionSate_enm, implementation-data-type=uint8
  impl type VehStatus_struct: category=STRUCTURE
    element GearState_enm: implementation-data-type=VehicleGearState_enm
    element AirState_enm: implementation-data-type=AirSuspensionSate_enm
    element isVehStateValid_bl: implementation-data-type=boolean
package /DataTypes/CppImplementationDataTypes
  14 x std cpp implementation data type:
    bool: category=VALUE, type-emitter=FundamentalType  # Boolean value (true/false)
    float: category=VALUE, type-emitter=FundamentalType  # IEEE 754 single-precision floating-point (32-bit)
    double: category=VALUE, type-emitter=FundamentalType  # IEEE 754 double-precision floating-point (64-bit)
    int8_t: category=VALUE, header-file=cstdint  # Signed 8-bit integer (-128 to 127)
    int16_t: category=VALUE, header-file=cstdint  # Signed 16-bit integer (-32,768 to 32,767)
    int32_t: category=VALUE, header-file=cstdint  # Signed 32-bit integer (-2,147,483,648 to 2,147,483,647)
    int64_t: category=VALUE, header-file=cstdint  # Signed 64-bit integer
    uint8_t: category=VALUE, header-file=cstdint  # Unsigned 8-bit integer (0 to 255)
    uint16_t: category=VALUE, header-file=cstdint  # Unsigned 16-bit integer (0 to 65,535)
    uint32_t: category=VALUE, header-file=cstdint  # Unsigned 32-bit integer (0 to 4,294,967,295)
    uint64_t: category=VALUE, header-file=cstdint  # Unsigned 64-bit integer
    VehicleGearState_enm: compu-method=CM_VehicleGearState_enm, type-reference=uint8_t
      namespaces:
        symbol props sensor
        symbol props gearstate
    AirSuspensionSate_enm: compu-method=CM_AirSuspensionSate_enm, type-reference=uint8_t
      namespaces:
        symbol props sensor
        symbol props airstate
    VehStatus_struct: category=STRUCTURE
      namespaces:
        symbol props sensor
        symbol props vehstatus
      cpp implementation data type element GearState_enm: type-reference=VehicleGearState_enm
      cpp implementation data type element AirState_enm: type-reference=AirSuspensionSate_enm
      cpp implementation data type element isVehStateValid_bl: type-reference=bool
package /DataTypes/ApplicationDataTypes
  13 x app type:
    boolean: category=BOOLEAN  # Boolean value (true/false)
    float32: category=VALUE  # IEEE 754 single-precision floating-point (32-bit)
    float64: category=VALUE  # IEEE 754 double-precision floating-point (64-bit)
    sint8: category=VALUE  # Signed 8-bit integer (-128 to 127)
    sint16: category=VALUE  # Signed 16-bit integer (-32,768 to 32,767)
    sint32: category=VALUE  # Signed 32-bit integer (-2,147,483,648 to 2,147,483,647)
    sint64: category=VALUE  # Signed 64-bit integer
    uint8: category=VALUE  # Unsigned 8-bit integer (0 to 255)
    uint16: category=VALUE  # Unsigned 16-bit integer (0 to 65,535)
    uint32: category=VALUE  # Unsigned 32-bit integer (0 to 4,294,967,295)
    uint64: category=VALUE  # Unsigned 64-bit integer
    VehicleGearState_enm: category=VALUE, compu-method=CM_VehicleGearState_enm
    AirSuspensionSate_enm: category=VALUE, compu-method=CM_AirSuspensionSate_enm
  application record data type VehStatus_struct: category=STRUCTURE
    application record element GearState_enm: category=VALUE, type=VehicleGearState_enm
    application record element AirState_enm: category=VALUE, type=AirSuspensionSate_enm
    application record element isVehStateValid_bl: category=BOOLEAN, type=boolean
package /DataTypes/DataTypeMappingSets
  data type mapping set DataTypeMappingsCP
    data-type-maps:
      application-data-type=boolean, implementation-data-type=boolean
      application-data-type=float32, implementation-data-type=float32
      application-data-type=float64, implementation-data-type=float64
      application-data-type=sint8, implementation-data-type=sint8
      application-data-type=sint16, implementation-data-type=sint16
      application-data-type=sint32, implementation-data-type=sint32
      application-data-type=sint64, implementation-data-type=sint64
      application-data-type=uint8, implementation-data-type=uint8
      application-data-type=uint16, implementation-data-type=uint16
      application-data-type=uint32, implementation-data-type=uint32
      application-data-type=uint64, implementation-data-type=uint64
      application-data-type=VehicleGearState_enm, implementation-data-type=VehicleGearState_enm
      application-data-type=AirSuspensionSate_enm, implementation-data-type=AirSuspensionSate_enm
      application-data-type=VehStatus_struct, implementation-data-type=VehStatus_struct
  data type mapping set DataTypeMappingsAP
    data-type-maps:
      application-data-type=boolean, implementation-data-type=bool
      application-data-type=float32, implementation-data-type=float
      application-data-type=float64, implementation-data-type=double
      application-data-type=sint8, implementation-data-type=int8_t
      application-data-type=sint16, implementation-data-type=int16_t
      application-data-type=sint32, implementation-data-type=int32_t
      application-data-type=sint64, implementation-data-type=int64_t
      application-data-type=uint8, implementation-data-type=uint8_t
      application-data-type=uint16, implementation-data-type=uint16_t
      application-data-type=uint32, implementation-data-type=uint32_t
      application-data-type=uint64, implementation-data-type=uint64_t
      application-data-type=VehicleGearState_enm, implementation-data-type=VehicleGearState_enm
      application-data-type=AirSuspensionSate_enm, implementation-data-type=AirSuspensionSate_enm
      application-data-type=VehStatus_struct, implementation-data-type=VehStatus_struct
package /DataTypes/CompuMethods
  compu method CM_VehicleGearState_enm: 0=VehGearState_Parking_enm, 1=VehGearState_Reverse_enm, 2=VehGearState_Neutral_enm, 3=VehGearState_Drive_enm, 4=VehGearState_Invalid_enm
  compu method CM_AirSuspensionSate_enm: 0=AirSuspensionState_VeryHigh_enm, 1=AirSuspensionState_High_enm, 2=AirSuspensionState_Normal_enm, 3=AirSuspensionState_Low_enm, 4=AirSuspensionState_VeryLow_enm, 5=AirSuspensionState_None_enm, 6=AirSuspensionState_Invalid_enm
