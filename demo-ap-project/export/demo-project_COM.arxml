AUTOSAR XML (schema 00054)
package /System/MachineDesign
  machine design HPC_0: service-discovery-configs=someip-service-discovery={multicast-sd-ip-address=HPC_0_HPC_0_Ethernet_Connector_0_Multicast, someip-service-discovery-port=50}
    ethernet communication connector HPC_0_Ethernet_Connector_0: comm-controller=HPC_0_Ethernet_Controller_0
      ap application endpoint HPC_0_HPC_0_Ethernet_Connector_0_UDP_0: tp-configuration=udp-tp=udp-tp-port=port-number=0
    ethernet communication controller HPC_0_Ethernet_Controller_0
package /System/CommunicationCluster/Ethernet
  ethernet cluster EthernetCluster_0
    ethernet physical channel PhysicalChannel: comm-connectors=HPC_0_Ethernet_Connector_0
      network endpoint HPC_0_HPC_0_Ethernet_Connector_0_Multicast: network-endpoint-addresses=ipv-4-configuration={assignment-priority=0, ipv-4-address=192.168.10.10, ipv-4-address-source=FIXED, ttl=0}
      so-ad-config:
        socket address HPC_0_HPC_0_Ethernet_Connector_0_Multicast_Socket: multicast-connector=HPC_0_Ethernet_Connector_0
          application endpoint ApplicationEndpoint: network-endpoint=HPC_0_HPC_0_Ethernet_Connector_0_Multicast, tp-configuration=udp-tp=udp-tp-port=port-number=50
package /System/Pdu/ISignalIPdu
  pdu MainApp2IVI_SendVehStatusEvent_PDU: length=11, unused-bit-pattern=0
    signal MainApp2IVI_SendVehStatusEvent_ISignal: start 0, 88 bit, little-endian, system signal MainApp2IVI_SendVehStatusEvent_SystemSignal, data-transformations=SomeipTransformation_V1, data-type-policy=TRANSFORMING-I-SIGNAL, i-signal-type=ARRAY, someip-transformation-i-signal-props{transformer=SomeipTransformer_V1, interface-version=1}
  pdu GearSensor2MainApp_GetVehicleStatus_Event_PDU: length=11, unused-bit-pattern=0
    signal GearSensor2MainApp_GetVehicleStatus_Event_ISignal: start 0, 88 bit, little-endian, system signal GearSensor2MainApp_GetVehicleStatus_Event_SystemSignal, data-transformations=SomeipTransformation_V1, data-type-policy=TRANSFORMING-I-SIGNAL, i-signal-type=ARRAY, someip-transformation-i-signal-props{transformer=SomeipTransformer_V1, interface-version=1}
package /System/Signal/SG_CompuMethod
  compu method SG_MainApp2IVI_SendVehStatusEvent_ISignal: phys=raw
  compu method SG_GearSensor2MainApp_GetVehicleStatus_Event_ISignal: phys=raw
package /System/Signal/SG_DataConstr
  range SG_MainApp2IVI_SendVehStatusEvent_ISignal: phys 0
  range SG_GearSensor2MainApp_GetVehicleStatus_Event_ISignal: phys 0
package /System/NetworkManagement
  nm config NmConfig
    udp nm cluster NmCluster_EthernetCluster_0: communication-cluster=EthernetCluster_0, nm-message-timeout-time=2, nm-msg-cycle-time=0.5, nm-network-timeout=2, nm-remote-sleep-indication-time=1, nm-repeat-message-time=1, nm-wait-bus-sleep-time=1.5
      udp nm node HPC_0: controller=HPC_0_Ethernet_Controller_0, machine=HPC_0, nm-if-ecu=HPC_0, nm-node-id=0, communication-connector=HPC_0_Ethernet_Connector_0, nm-msg-cycle-offset=0
    nm-if-ecus:
      nm ecu HPC_0
package /System/DataTransformation
  data transformation set SomeipTransformationSet
    data transformation SomeipTransformation_V1: transformer-chain=SomeipTransformer_V1
    transformation technology SomeipTransformer_V1: buffer-properties={header-length=64, in-place=false}, protocol=SOMEIP, someip-transformation-description{alignment=8, byte-order=big-endian, interface-version=1}, transformer-class=SERIALIZER, version=1.0.0
package /System/Service/Deployment/SOMEIP
  someip service interface deployment MainApp2IVI: service-interface=MainApp2IVI, service-interface-id=1110, service-interface-version={major-version=1, minor-version=0}
    someip event deployment SendVehStatusEvent: event=SendVehStatusEvent, event-id=1, transport-protocol=UDP
    someip event group EG_SendVehStatusEvent: event-group-id=1, event=SendVehStatusEvent
  someip service interface deployment GearSensor2MainApp: service-interface=GearSensor2MainApp, service-interface-id=291, service-interface-version={major-version=1, minor-version=0}
    someip event deployment GetVehicleStatus_Event: event=GetVehicleStatus_Event, event-id=1, transport-protocol=UDP
    someip event group EG_GetVehicleStatus_Event: event-group-id=1, event=GetVehicleStatus_Event
package /System/Service/Instance/SOMEIP/Provider
  provided someip service instance Provider_GearSensor2MainApp_1: service-interface-deployment=GearSensor2MainApp, sd-server-config=SdServerConfig_Provider_GearSensor2MainApp_1, service-instance-id=1
    someip provided event group EG_GetVehicleStatus_Event: event-group=EG_GetVehicleStatus_Event, multicast-threshold=0
  provided someip service instance Provider_MainApp2IVI_1: service-interface-deployment=MainApp2IVI, sd-server-config=SdServerConfig_Provider_MainApp2IVI_1, service-instance-id=1
    someip provided event group EG_SendVehStatusEvent: event-group=EG_SendVehStatusEvent, multicast-threshold=0
package /System/Service/Instance/SOMEIP/Consumer
  required someip service instance Consumer_MainApp2IVI_1: service-interface-deployment=MainApp2IVI, required-minor-version=ANY, required-service-instance-id=ANY, sd-client-config=SdClientConfig_Consumer_MainApp2IVI_1, version-driven-find-behavior=EXACT-OR-ANY-MINOR-VERSION
    someip required event group EG_SendVehStatusEvent: event-group=EG_SendVehStatusEvent, sd-client-event-group-timing-config=SdEventgroupConfig_Consumer_MainApp2IVI_1_EG_SendVehStatusEvent
  required someip service instance Consumer_GearSensor2MainApp_1: service-interface-deployment=GearSensor2MainApp, required-minor-version=ANY, required-service-instance-id=ANY, sd-client-config=SdClientConfig_Consumer_GearSensor2MainApp_1, version-driven-find-behavior=EXACT-OR-ANY-MINOR-VERSION
    someip required event group EG_GetVehicleStatus_Event: event-group=EG_GetVehicleStatus_Event, sd-client-event-group-timing-config=SdEventgroupConfig_Consumer_GearSensor2MainApp_1_EG_GetVehicleStatus_Event
package /System/Service/Instance/SOMEIP/SdServerConfig
  someip sd server service instance config SdServerConfig_Provider_GearSensor2MainApp_1: initial-offer-behavior={initial-delay-max-value=0.1, initial-delay-min-value=0.01, initial-repetitions-base-delay=0.2, initial-repetitions-max=3}, offer-cyclic-delay=0.5, request-response-delay={max-value=0, min-value=0}, service-offer-time-to-live=16777215
  someip sd server service instance config SdServerConfig_Provider_MainApp2IVI_1: initial-offer-behavior={initial-delay-max-value=0.1, initial-delay-min-value=0.01, initial-repetitions-base-delay=0.2, initial-repetitions-max=3}, offer-cyclic-delay=0.5, request-response-delay={max-value=0, min-value=0}, service-offer-time-to-live=16777215
package /System/Service/Instance/SOMEIP/SdClientConfig
  someip sd client service instance config SdClientConfig_Consumer_MainApp2IVI_1: initial-find-behavior={initial-delay-max-value=0.1, initial-delay-min-value=0.01, initial-repetitions-base-delay=0.2, initial-repetitions-max=3}, service-find-time-to-live=16777215
  someip sd client service instance config SdClientConfig_Consumer_GearSensor2MainApp_1: initial-find-behavior={initial-delay-max-value=0.1, initial-delay-min-value=0.01, initial-repetitions-base-delay=0.2, initial-repetitions-max=3}, service-find-time-to-live=16777215
package /System/Service/Endpoint/SOMEIP
  4 x someip service instance to machine mapping, all with communication-connector=HPC_0_Ethernet_Connector_0:
    HPC_0_ProviderMapping_Provider_GearSensor2MainApp_1: service-instance=Provider_GearSensor2MainApp_1
    HPC_0_ProviderMapping_Provider_MainApp2IVI_1: service-instance=Provider_MainApp2IVI_1
    HPC_0_ConsumerMapping_Consumer_MainApp2IVI_1: service-instance=Consumer_MainApp2IVI_1
    HPC_0_ConsumerMapping_Consumer_GearSensor2MainApp_1: service-instance=Consumer_GearSensor2MainApp_1
package /System/Service/SignalMapping
  4 x service instance to signal mapping:
    Provider_GearSensor2MainApp_1_SigMap: service-instance=Provider_GearSensor2MainApp_1
      event-element-mappings:
        signal based event element to i signal triggering mapping Provider_GearSensor2MainApp_1_SigMap_Ev0
    Provider_MainApp2IVI_1_SigMap: service-instance=Provider_MainApp2IVI_1
      event-element-mappings:
        signal based event element to i signal triggering mapping Provider_MainApp2IVI_1_SigMap_Ev0
    Consumer_MainApp2IVI_1_SigMap: service-instance=Consumer_MainApp2IVI_1
      event-element-mappings:
        signal based event element to i signal triggering mapping Consumer_MainApp2IVI_1_SigMap_Ev0
    Consumer_GearSensor2MainApp_1_SigMap: service-instance=Consumer_GearSensor2MainApp_1
      event-element-mappings:
        signal based event element to i signal triggering mapping Consumer_GearSensor2MainApp_1_SigMap_Ev0
