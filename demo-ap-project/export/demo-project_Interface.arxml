AUTOSAR XML (schema 00054)
package /PortInterface/ClientServer
  client server interface ClientServerInterface_0
package /PortInterface/SenderReceiver
  sender receiver interface MainApp2IVI_SR
    data SendVehStatusEvent: type=VehStatus_struct
  sender receiver interface GearSensor2MainApp_SR
    data GetVehicleStatus_Event: type=VehStatus_struct
package /PortInterface/Service
  service interface GearSensor2MainApp: major-version=1, minor-version=0
    namespaces:
      symbol props comm
      symbol props gear2main
    events:
      data GetVehicleStatus_Event: type=VehStatus_struct  # Getting Vehicle Status from the GearSensor.
  service interface MainApp2IVI: major-version=1, minor-version=0
    namespaces:
      symbol props comm
      symbol props main2ivi
    events:
      data SendVehStatusEvent: type=VehStatus_struct
package /PortInterface/Adaptive/LogAndTrace
  log and trace interface Logging_and_Tracing
    namespaces:
      symbol props ara
      symbol props log
